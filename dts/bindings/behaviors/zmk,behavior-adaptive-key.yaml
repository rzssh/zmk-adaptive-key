## dts/bindings/behaviors/zmk,behavior-adaptive-key.yaml
```yaml
# Copyright (c) 2024 The ZMK Contributors
# SPDX-License-Identifier: MIT

description: Adaptive key behavior

compatible: "zmk,behavior-adaptive-key"

include: zero_param.yaml

properties:
  bindings:
    type: phandle-array
    description: |
      Default binding if no trigger condition is met.
    required: true
  dead-keys:
    type: array
    description: |
      List of key codes that are converted into dead keys.
    default: []
  delete-keycode:
    type: int
    description: |
      Keycode to press when delete-prior is set.
  skip-magic:
    type: boolean
    description: Match the previous keycode instead of the last; repeat it on no match.
  input-key:
    type: int
    default: 0

child-binding:
  description: "An adaptive key condition"

  properties:
    bindings:
      type: phandle-array
      required: true
    trigger-keys:
      type: array
      required: true
    prior-trigger-keys:
      type: array
      default: []
      description: Also require the previous keycode to match one of these.
    prior-keys:
      type: array
      default: []
      description: Ordered keycodes that must precede the trigger match (oldest first).
    max-prior-idle-ms:
      type: int
      default: -1
    min-prior-idle-ms:
      type: int
      default: -1
    delete-prior:
      type: boolean
    strict-modifiers:
      type: boolean
    continue-swap:
      type: boolean
    continue-shift:
      type: boolean
    swap-key:
      type: int
      default: 0
```
